## main/Kconfig
```kconfig
menu "GSM PPPoS configuration"

config GSM_DEBUG
    bool "Enable GSM debugging"
    default y
    help
        Show GSM debug messages

config GSM_TX
    int "UART Output to GSM Module"
    default 17
    range 1 30
    help
	UART Tx pin, connected to GSM Module Rx pin.

config GSM_RX
    int "UART Input from GSM Module"
    default 16
    range 1 38
    help
	UART Rx pin, connected to GSM Module Tx pin.

config GSM_BDRATE
    int "UART Baud rate"
    default 115200
    help
	UART baudrate to comunicate with GSM module

config GSM_INTERNET_USER
    string "Internet User"
	default ""
	help
		Network provider internet user.

config GSM_INTERNET_PASSWORD
    string "Internet password"
	default ""
	help
		Network provider internet password
		
config GSM_APN
    string "Internet APN"
    default "providerAPN"
    help
       Network provider's APN for internet access

config GSM_USE_WIFI_AP
    bool "Start WiFi and AP"
    default n
    help
        Start WiFi as Acces Point and create WebServer task

config GSM_SEND_SMS
    bool "Send SMS message"
    default n
    help
        Send SMS messages during example run

config GSM_SMS_NUMBER
    string "SMS number"
   	depends on GSM_SEND_SMS
    default "+1998765432"
    help
       SMS number for sending messages
       Enter the number in international format (+123999876543)

config GSM_SMS_INTERVAL
    int "SMS message interval"
   	depends on GSM_SEND_SMS
    default 300000
    range 180000 3600000
    help
	    Set SMS message interval in mili seconds
config EN_TT_PIN
    int "enable tt pin"
    default 14
    help
	    enable tiantong power pin
config EN_VOLTAGE_TRANSLATION_PIN
    int "enable VT pin"
    default 13
    help
	    enable tiantong module 3v3to1v8 pin
config 4G_TX
    int "4gModule TX PIN"
    default 26
    range 1 36
    help
        4gModuleTxPin
config 4G_RX
    int "4gModule RX PIN"
    default 27
    range 1 36
    help
        4gModuleRxPin
config 4G_BDRATE
    int "UART Baud rate"
    default 115200
    help
	    UART baudrate to comunicate with G4 module
config G4_DEBUG
    bool "Enable G4 debugging"
    default 1
    help
        Show G4 debug messages
endmenu
```
